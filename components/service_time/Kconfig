## components/service_time/Kconfig
```kconfig
menu "Dashboard Time"

config DASH_TIMEZONE_TZ
    string "Default timezone TZ string"
    default "CST-8"
    help
        POSIX TZ string used when no timezone value exists in NVS.

endmenu
```

## sdkconfig.defaults
```kconfig
# Default sdkconfig seed for the ESP32 dashboard firmware scaffold.
# Baseline derived from the official Waveshare ESP-IDF examples for
# ESP32-S3-Touch-LCD-3.49 and trimmed for the current P0 bring-up.

CONFIG_IDF_TARGET="esp32s3"
CONFIG_ESPTOOLPY_FLASHSIZE_16MB=y
CONFIG_ESPTOOLPY_FLASHMODE_DIO=y
CONFIG_ESPTOOLPY_FLASHFREQ_80M=y
CONFIG_PARTITION_TABLE_CUSTOM=y
CONFIG_PARTITION_TABLE_CUSTOM_FILENAME="partitions.csv"
CONFIG_COMPILER_OPTIMIZATION_PERF=y

CONFIG_SPIRAM=y
CONFIG_SPIRAM_MODE_OCT=y
CONFIG_SPIRAM_SPEED_80M=y
CONFIG_SPIRAM_USE_MALLOC=y
CONFIG_SPIRAM_MALLOC_ALWAYSINTERNAL=16384
CONFIG_SPIRAM_MALLOC_RESERVE_INTERNAL=32768

CONFIG_FREERTOS_HZ=1000
CONFIG_LWIP_SNTP_MAX_SERVERS=3
CONFIG_NVS_ENCRYPTION=y
CONFIG_NVS_SEC_KEY_PROTECT_USING_HMAC=y
CONFIG_NVS_SEC_HMAC_EFUSE_KEY_ID=0

CONFIG_LV_COLOR_DEPTH_16=y
CONFIG_LV_OS_FREERTOS=y
CONFIG_LV_DRAW_SW_SUPPORT_RGB565=y
CONFIG_LV_DRAW_SW_SUPPORT_RGB565A8=y
CONFIG_LV_DRAW_SW_COMPLEX=y
CONFIG_LV_FONT_MONTSERRAT_12=y
CONFIG_LV_FONT_MONTSERRAT_14=y
CONFIG_LV_FONT_MONTSERRAT_16=y
CONFIG_LV_FONT_MONTSERRAT_20=y
CONFIG_LV_FONT_MONTSERRAT_24=y
CONFIG_LV_FONT_MONTSERRAT_48=y
CONFIG_LV_USE_PERF_MONITOR=y
CONFIG_LV_USE_OBSERVER=y
CONFIG_LV_BUILD_EXAMPLES=n
CONFIG_LV_BUILD_DEMOS=n
```

## src/components/net_manager/Kconfig
```kconfig
menu "Dashboard Network"

comment "Wi-Fi profiles are managed at runtime through esp32dash config."

endmenu
```

## src/components/service_time/Kconfig
```kconfig
menu "Dashboard Time"

config DASH_TIMEZONE_NAME
    string "Default timezone display name"
    default "Asia/Shanghai"
    help
        Friendly IANA timezone name shown in host-side configuration UI.

config DASH_TIMEZONE_TZ
    string "Default timezone TZ string"
    default "CST-8"
    help
        POSIX TZ string used when no timezone value exists in NVS.

endmenu
```

## src/components/service_weather/Kconfig
```kconfig
menu "Dashboard Weather"

config DASH_WEATHER_CITY_LABEL
    string "Default weather city label"
    default "Shanghai"
    help
        Fixed city label shown on Home in v1. This is only display text and
        does not affect API lookup.

config DASH_WEATHER_LATITUDE
    string "Default weather latitude"
    default "31.2304"
    help
        Fixed latitude used for the Open-Meteo current weather request.

config DASH_WEATHER_LONGITUDE
    string "Default weather longitude"
    default "121.4737"
    help
        Fixed longitude used for the Open-Meteo current weather request.

endmenu
```
